## firmware/esp-bridge/main/Kconfig.projbuild
```kconfig
menu "Network Credentials"

    config WIFI_SSID
        string "WiFi SSID"
        default ""
        help
            The network name you want to connect to.
    
    config WIFI_PASSWORD
        string "WiFi password"
        default ""
        help
            Your WiFi password.

    config MQTT_BROKER_ADR
        string "MQTT broker IP address"
        default ""
        help
            Local IP of the machine running Mosquitto.
                
endmenu
```

## firmware/esp-sensor/main/Kconfig.projbuild
```kconfig
menu "Hardware Configuration"

    config BRIDGE_MAC_ADR
        string "ESP bridge MAC address"
        default ""
        help
            MAC address of the ESP-Bridge in format F4:2D:C9:6B:EE:38

    config ESPNOW_CHANNEL
        int "ESP-NOW channel"
        default 1
        help
            ESP-NOW channel must match the WiFi channel of the bridge's router.

    config SDA_PIN_NUM
        int "BME280 SDA pin number"
        default 21
        help
            GPIO pin number for I2C SDA line connected to BME280.

    config SCL_PIN_NUM
        int "BME280 SCL pin number"
        default 22
        help
            GPIO pin number for I2C SCL line connected to BME280.

endmenu
```
